## meta-scobc/conf/machine/include/scobc-reva.inc
```bitbake
MACHINEOVERRIDES =. "${@['', 'scobc-v1-reva:']['scobc-v1-reva' != '${MACHINE}']}"
```

## meta-scobc/conf/machine/include/scobc-v1-revb.inc
```bitbake
MACHINEOVERRIDES =. "${@['', 'scobc-v1-revb:']['scobc-v1-revb' != '${MACHINE}']}"
```

## meta-scobc/conf/machine/include/versal-scobc-v1-ve2302e-revb-sdt-full/versal-scobc-v1-ve2302e-revb-sdt-full-microblaze-psm-features.conf
```bitbake
MACHINE_FEATURES = "cframe cfupmc common csudma emacps gpiops iicps iomodule ipipsu qspipsu rtcpsu sdps spips sysmonpsv tmr-inject tmr-manager trngpsv ttcps uartlite uartpsv usbpsu wdttb xdmapcie zdma"
```
