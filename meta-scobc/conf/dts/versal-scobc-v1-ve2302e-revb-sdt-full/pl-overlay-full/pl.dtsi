/dts-v1/;
/plugin/;
&fpga {
	firmware-name = "sc_obc_v1_versal_ve2302e_4d29d204.pdi";
};

&amba {
	sc_gpio_bd: sc_gpio_bd@80000000 {
		compatible = "xlnx,sc-gpio-bd-1.0";
		clock-names = "SYS_CLK";
		xlnx,ip-name = "sc_gpio_bd";
		xlnx,edk-iptype = "PERIPHERAL";
		reg = <0x0 0x80000000 0x0 0x10000>;
		clocks = <&versal_clk 65>;
		xlnx,name = "sc_gpio_bd";
	};
};
