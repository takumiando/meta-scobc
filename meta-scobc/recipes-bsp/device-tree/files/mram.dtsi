/*
&qspi {
	status = "okay";

	/delete-node/ flash@0;

	mram0: mram@0 {
		#address-cells = <1>;
		#size-cells = <1>;
		compatible = "jedec,spi-nor";
		reg = <0 1>;
		parallel-memories = <0x0 0x04000000 0x0 0x04000000>;
		spi-tx-bus-width = <1>;
		spi-rx-bus-width = <4>;
		spi-max-frequency = <50000000>;

		partition@0 {
			label = "mram0";
			reg = <0x0 0x08000000>;
		};
	};
};
*/

&qspi {
	status = "okay";

	num-cs = <1>;
	is-dual = <0>;
	xlnx,connection-mode = <0>;
	xlnx,qspi-mode = <0>;

	spi-tx-bus-width = <1>;
	spi-rx-bus-width = <4>;

	flash@0 {
		reg = <0>;

		/delete-property/ parallel-memories;

		spi-tx-bus-width = <1>;
		spi-rx-bus-width = <4>;
		spi-max-frequency = <40000000>;
	};
};
